/*
 * Zedboard DTS file header for sdcard/mmc partition 2 boot.
 */

/dts-v1/;
/include/ "zc702-zynq7.dtsi"
/ {
	chosen {
	       bootargs = "console=ttyPS0,115200 root=/dev/mmcblk0p2 rw rootfstype=ext4 ip=:::::eth0:dhcp earlyprintk rootwait";
	} ;

	ps7_axi_interconnect_0: amba@0 {
		user_peripheral@40000000 {
			compatible = "gnuradio,user_peripheral";
			reg = <0x40000000 0x20000>;
			interrupts = < 0 59 1 >;
			interrupt-parent = <&ps7_scugic_0>;
		};
	};
} ;
