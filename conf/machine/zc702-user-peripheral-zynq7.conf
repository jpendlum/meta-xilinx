## conf/machine/zc702-user-peripheral-zynq7.conf
```bitbake
#@TYPE: Machine
#@NAME: zc702-zynq7-user-peripheral
#@DESCRIPTION: Machine support for ZC702 Evaluation Board with user peripheral.

PREFERRED_VERSION_linux-xlnx ?= "3.8%"
PREFERRED_VERSION_u-boot-xlnx ?= "v2013.01%"

require conf/machine/include/tune-zynq.inc
require conf/machine/include/machine-xilinx-default.inc

# ZC70x machine definition known by Xilinx UBOOT
UBOOT_MACHINE = "zynq_zc70x_config"

SERIAL_CONSOLE = "115200 ttyPS0"

MACHINE_DEVICETREE := "\
                    	zc702/zc702-zynq7.dtsi \
                      zc702-user-peripheral/zc702-user-peripheral-zynq7.dts"
MACHINE_KCONFIG := "common/rtc.cfg"
```

## conf/machine/zc706-user-peripheral-zynq7.conf
```bitbake
#@TYPE: Machine
#@NAME: zc706-zynq7-user-peripheral
#@DESCRIPTION: Machine support for ZC706 Evaluation Board with user peripheral
#

PREFERRED_VERSION_linux-xlnx ?= "3.8%"
PREFERRED_VERSION_u-boot-xlnx ?= "v2013.01%"

require conf/machine/include/tune-zynq.inc
require conf/machine/include/machine-xilinx-default.inc

# ZC70x machine definition known by Xilinx UBOOT
UBOOT_MACHINE = "zynq_zc70x_config"

SERIAL_CONSOLE = "115200 ttyPS0"

MACHINE_DEVICETREE := "\
                      zc706/zc706-zynq7.dtsi \
                      zc706-user-peripheral/zc706-user-peripheral-zynq7.dts"
MACHINE_KCONFIG := "common/rtc.cfg"
```

## conf/machine/zedboard-user-peripheral-zynq7.conf
```bitbake
#@TYPE: Machine
#@NAME: zedboard-zynq7-user-peripheral
#@DESCRIPTION: Machine support for ZedBoard with user peripheral. (http://www.zedboard.org/)

# Versions corresponding to zedboard documentation
PREFERRED_VERSION_linux-xlnx ?= "3.8%"
PREFERRED_VERSION_u-boot-xlnx ?= "v2013.01%"

require conf/machine/include/tune-zynq.inc
require conf/machine/include/machine-xilinx-default.inc

# Zedboard machine definition known by Xilinx UBOOT
UBOOT_MACHINE = "zynq_zed_config"

SERIAL_CONSOLE = "115200 ttyPS0"

MACHINE_DEVICETREE := " \
		zedboard/zedboard-zynq7.dtsi \
		zedboard-user-peripheral/zedboard-user-peripheral-zynq7.dts \
		"
```
